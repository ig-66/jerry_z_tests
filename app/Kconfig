## app/Kconfig
```kconfig
# Copyright (c) 2019-2020 Nordic Semiconductor ASA
# SPDX-License-Identifier: Apache-2.0

choice
	prompt "JerryZ sample to be built"
	default JERRYZ_EXAMPLE_THREAD_SIMPLE
	help
	  Specify the JerryZ sample to be built.

	config JERRYZ_EXAMPLE_THREAD_SIMPLE
		bool "Build the simple thread JerryZ sample"
		select CONFIG_JERRY_PARSER

	config JERRYZ_EXAMPLE_SNAP_LOAD
		bool "Build the snapshot file sample"
		select JERRY_SNAPSHOT_EXEC
		select USB_DEVICE_STACK
		select USB_MASS_STORAGE
		select DISK_ACCESS
		select DISK_DRIVERS
		select FILE_SYSTEM
		select FAT_FILESYSTEM_ELM
		select FS_FATFS_LFN
		select LOG

	config JERRYZ_EXAMPLE_SNAPSHOT
		bool "Build snapshot save and execute example"
		select JERRY_SNAPSHOT_EXEC
		select JERRY_SNAPSHOT_SAVE

	config JERRYZ_EXAMPLE_PRINT_HANDLER
		bool "Build simple parser JerryZ example"
		select JERRY_PARSER

	config JERRYZ_SETTIMEOUT_TEST
		bool "Build the set timeout TEST?"
		select JERRY_PARSER
	
	config FIELDFARE
		bool "Test fieldfare"

endchoice
	
if JERRYZ_EXAMPLE_SNAP_LOAD
	
	config MASS_STORAGE_STACK_SIZE
		default 768

	config JERRY_PARSER
		default n

endif # JERRYZ_EXAMPLE_SNAP_LOAD

if JERRYZ_EXAMPLE_SNAPSHOT

	config JERRY_PARSER
		default n

endif # JERRYZ_EXAMPLE_SNAPSHOT

config USB_DEVICE_PID
	default 0x0008 

config APP_WIPE_STORAGE
	bool "Option to clear the flash area before mounting"
	help
	  Use this to force an existing file system to be created.

choice
	prompt "Storage and file system type used by the application"
	default APP_MSC_STORAGE_NONE
	help
	  Specify the type of storage and file system.

config APP_MSC_STORAGE_NONE
	bool "No block device"
	imply DISK_DRIVER_SDMMC

config APP_MSC_STORAGE_FLASH_FATFS
	bool "Use FLASH disk and FAT file system"
	imply DISK_DRIVER_FLASH
	imply FILE_SYSTEM
	imply FAT_FILESYSTEM_ELM

config APP_MSC_STORAGE_FLASH_LITTLEFS
	bool "Use FLASH disk and LittleFS"
	imply DISK_DRIVER_FLASH
	imply FILE_SYSTEM
	imply FILE_SYSTEM_LITTLEFS

config APP_MSC_STORAGE_SDCARD
	bool "Use SDHC and FAT file system"
	# imply DISK_DRIVER_SDMMC
	# imply FILE_SYSTEM
	# imply FAT_FILESYSTEM_ELM
	select SDHC
	select SPI_SDHC
	select SDMMC_SUBSYS
	select DISK_DRIVER_SDMMC

endchoice


config MASS_STORAGE_DISK_NAME
	default "NAND" if DISK_DRIVER_FLASH
	default "SD" if DISK_DRIVER_SDMMC

if DISK_DRIVER_FLASH

config FLASH_MAP
	default y

config FLASH_PAGE_LAYOUT
	default y

config DISK_FLASH_START
	default 0x0

config FLASH_LOG_LEVEL
	default 3

DT_COMPAT_QSPI_NOR := nordic,qspi-nor

config NORDIC_QSPI_NOR
	default $(dt_compat_enabled,$(DT_COMPAT_QSPI_NOR))

if NORDIC_QSPI_NOR

config NORDIC_QSPI_NOR_FLASH_LAYOUT_PAGE_SIZE
	default 4096

config DISK_FLASH_DEV_NAME
	default "MX25R64" if "$(dt_nodelabel_enabled,mx25r64)"
	default "GD25Q16" if "$(dt_nodelabel_enabled,gd25q16)"

config DISK_VOLUME_SIZE
	default 0x20000

config DISK_FLASH_MAX_RW_SIZE
	default 4096

config DISK_FLASH_ERASE_ALIGNMENT
	default 0x1000

config DISK_ERASE_BLOCK_SIZE
	default 0x1000

endif # NORDIC_QSPI_NOR

endif # DISK_DRIVER_FLASH

source "Kconfig.zephyr"
```

## west.yml
```yaml
manifest:

  self:
    path: jerry_z_tests
  
  remotes:
    - name: zephyrproject-rtos
      url-base: https://github.com/zephyrproject-rtos
    - name: moduhub
      url-base: https://bitbucket.org/moduhub
 
  projects:
  
    - name: zephyr
      remote: zephyrproject-rtos
      revision: v3.1.0
      import: true
  
    - name: hal_atmel
      remote: zephyrproject-rtos
      repo-path: hal_atmel
      path: modules/hal/atmel

    - name: zephyr_jerryscript
      url: https://github.com/moduhub/zephyr_jerryscript
      revision: master
      path: modules/lib/jerryscript
```
